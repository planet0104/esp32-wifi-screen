## scr/sdkconfig.defaults
```kconfig
# Rust often needs a bit of an extra main task stack size compared to C (the default is 3K)
CONFIG_ESP_MAIN_TASK_STACK_SIZE=8000

# Use this to set FreeRTOS kernel tick frequency to 1000 Hz (100 Hz by default).
# This allows to use 1 ms granularity for thread sleeps (10 ms by default).
# Enable for better network responsiveness
CONFIG_FREERTOS_HZ=1000

# Workaround for https://github.com/espressif/esp-idf/issues/7631
#CONFIG_MBEDTLS_CERTIFICATE_BUNDLE=n
#CONFIG_MBEDTLS_CERTIFICATE_BUNDLE_DEFAULT_FULL=n

#CONFIG_ESP_CONSOLE_SECONDARY_NONE=y
CONFIG_ESP_CONSOLE_USB_CDC=y
CONFIG_ESP_CONSOLE_USB_CDC_NUM=1

CONFIG_SPIRAM=y
CONFIG_SPIRAM_MODE_OCT=y
CONFIG_SPIRAM_SPEED_80M=y

#---------- PSRAM Memory Optimization ----------------
# Allow .bss segment in external memory (saves ~70K internal RAM)
CONFIG_SPIRAM_ALLOW_BSS_SEG_EXTERNAL_MEMORY=y

# WiFi/LWIP buffers in PSRAM first, fallback to internal if needed
CONFIG_SPIRAM_TRY_ALLOCATE_WIFI_LWIP=y

# Use malloc() for PSRAM (default behavior, allows standard allocation)
CONFIG_SPIRAM_USE_MALLOC=y

# Allocations smaller than this go to internal RAM (keep small for max PSRAM usage)
# Reduce from default 16384 to 4096 to put more data in PSRAM
CONFIG_SPIRAM_MALLOC_ALWAYSINTERNAL=4096

# Reserve internal memory for DMA and critical operations
# Reduce from default 32768 to 16384 to use more internal RAM for app
CONFIG_SPIRAM_MALLOC_RESERVE_INTERNAL=16384

# Skip memory test for faster boot (optional, enable for production)
#CONFIG_SPIRAM_MEMTEST=n

#
# ESP32S2-specific
#
# CONFIG_ESP32S2_DEFAULT_CPU_FREQ_80 is not set
# CONFIG_ESP32S2_DEFAULT_CPU_FREQ_160 is not set
CONFIG_ESP32S2_DEFAULT_CPU_FREQ_240=y
CONFIG_ESP32S2_DEFAULT_CPU_FREQ_MHZ=240
 
CONFIG_ESP_DEFAULT_CPU_FREQ_MHZ_240=y
CONFIG_ESP_DEFAULT_CPU_FREQ_MHZ=240

#CONFIG_ESPTOOLPY_FLASHMODE_QIO=y
#CONFIG_ESPTOOLPY_FLASHFREQ_80M=y


# ==================================================== wifi and network =============================

#---------- HTTP Server Optimization ----------------
# Enable WebSocket support
CONFIG_HTTPD_WS_SUPPORT=y

# Increase max request header length for browser compatibility
CONFIG_HTTPD_MAX_REQ_HDR_LEN=2048

# Increase max URI length for long query strings
CONFIG_HTTPD_MAX_URI_LEN=1024

# Enable TCP_NODELAY for faster error responses
CONFIG_HTTPD_ERR_RESP_NO_DELAY=y

# Increase purge buffer for faster data handling
CONFIG_HTTPD_PURGE_BUF_LEN=64

#=================================
# WiFi Performance Optimization for Maximum Speed
# https://docs.espressif.com/projects/esp-idf/zh_CN/latest/esp32s2/api-guides/performance/speed.html

#---------- WiFi Buffer Configuration (High Performance) ----------------
# Static RX buffer: Higher = better throughput, uses more DRAM
CONFIG_ESP_WIFI_STATIC_RX_BUFFER_NUM=16
# Dynamic RX buffer: Higher = better throughput
CONFIG_ESP_WIFI_DYNAMIC_RX_BUFFER_NUM=64
# Dynamic TX buffer
CONFIG_ESP_WIFI_DYNAMIC_TX_BUFFER_NUM=64

#---------- AMPDU (Block Acknowledgment) - Critical for speed ----------------
# Enable AMPDU for higher throughput
CONFIG_ESP_WIFI_AMPDU_TX_ENABLED=y
CONFIG_ESP_WIFI_TX_BA_WIN=32
CONFIG_ESP_WIFI_AMPDU_RX_ENABLED=y
CONFIG_ESP_WIFI_RX_BA_WIN=32

#---------- lwIP TCP/IP Stack Optimization ----------------
# Maximum TCP send buffer size
CONFIG_LWIP_TCP_SND_BUF_DEFAULT=65535
# Maximum TCP receive window size
CONFIG_LWIP_TCP_WND_DEFAULT=65535
# TCP/IP task mailbox sizes
CONFIG_LWIP_TCP_RECVMBOX_SIZE=64
CONFIG_LWIP_UDP_RECVMBOX_SIZE=64
CONFIG_LWIP_TCPIP_RECVMBOX_SIZE=64

#---------- WiFi IRAM Optimization (Enable for Speed) ----------------
# Place WiFi library functions in IRAM for faster execution
CONFIG_ESP_WIFI_IRAM_OPT=y
CONFIG_ESP_WIFI_RX_IRAM_OPT=y

#---------- Additional Performance Options ----------------
# Enable WiFi cache TX buffers (improve throughput)
CONFIG_ESP_WIFI_CACHE_TX_BUFFER_NUM=32

# lwIP additional optimizations
CONFIG_LWIP_IRAM_OPTIMIZATION=y
CONFIG_LWIP_TCP_MSS=1440

# Enable TCP_NODELAY by default (reduce latency for small packets)
CONFIG_LWIP_TCP_NODELAY=y

# Reduce TCP retransmission timeout for faster recovery
CONFIG_LWIP_TCP_RTO_TIME=1500

# Increase maximum segment lifetime
CONFIG_LWIP_TCP_MSL=60000

# Enable TCP keepalive
CONFIG_LWIP_TCP_KEEPALIVE=y
```

## scr/sdkconfig.defaults.esp32s3
```kconfig
# Rust often needs a bit of an extra main task stack size compared to C (the default is 3K)
CONFIG_ESP_MAIN_TASK_STACK_SIZE=8000

# Use custom partition table (relative to project root)
CONFIG_PARTITION_TABLE_CUSTOM=y
CONFIG_PARTITION_TABLE_CUSTOM_FILENAME="partitions.csv"

# Flash size configuration (4MB)
CONFIG_ESPTOOLPY_FLASHSIZE_4MB=y
CONFIG_ESPTOOLPY_FLASHSIZE="4MB"

# Use this to set FreeRTOS kernel tick frequency to 1000 Hz (100 Hz by default).
# This allows to use 1 ms granularity for thread sleeps (10 ms by default).
# Enable for better network responsiveness
CONFIG_FREERTOS_HZ=1000

# Workaround for https://github.com/espressif/esp-idf/issues/7631
#CONFIG_MBEDTLS_CERTIFICATE_BUNDLE=n
#CONFIG_MBEDTLS_CERTIFICATE_BUNDLE_DEFAULT_FULL=n

#CONFIG_ESP_CONSOLE_SECONDARY_NONE=y
CONFIG_ESP_CONSOLE_USB_SERIAL_JTAG=y

CONFIG_SPIRAM=y
# Use malloc() for PSRAM (enable allocation API)
CONFIG_SPIRAM_USE_MALLOC=y
# Many ESP32-S3 modules use Quad SPI PSRAM; prefer QUAD mode by default.
# If your board has Octal PSRAM, change this back to CONFIG_SPIRAM_MODE_OCT=y
CONFIG_SPIRAM_MODE_QUAD=y
CONFIG_SPIRAM_SPEED_80M=y

# ESP32-S3 PSRAM size configuration (2MB)
CONFIG_SPIRAM_SIZE=2097152

#---------- PSRAM Memory Optimization (2MB PSRAM) ----------------
# Allow .bss segment in external memory (saves ~70K internal RAM)
CONFIG_SPIRAM_ALLOW_BSS_SEG_EXTERNAL_MEMORY=y

# WiFi/LWIP buffers in PSRAM first, fallback to internal if needed
CONFIG_SPIRAM_TRY_ALLOCATE_WIFI_LWIP=y

# Use malloc() for PSRAM (default behavior, allows standard allocation)
# With 2MB PSRAM, can reduce internal RAM threshold to 2048
CONFIG_SPIRAM_MALLOC_ALWAYSINTERNAL=2048

# Reserve internal memory for DMA and critical operations
# With 2MB PSRAM, can reduce internal reservation to use more PSRAM
CONFIG_SPIRAM_MALLOC_RESERVE_INTERNAL=8192
# Reserve internal memory for DMA and critical operations
# Reduce from default 32768 to 16384 to use more internal RAM for app
CONFIG_SPIRAM_MALLOC_RESERVE_INTERNAL=16384

# *** CRITICAL: Allow pthread stacks in PSRAM (solves thread creation failures) ***
# This allows thread stacks to be allocated from PSRAM instead of internal RAM
CONFIG_SPIRAM_ALLOW_STACK_EXTERNAL_MEMORY=y

# Skip memory test for faster boot (optional, enable for production)
#CONFIG_SPIRAM_MEMTEST=n

#
# ESP32S3-specific
#
# CONFIG_ESP32S3_DEFAULT_CPU_FREQ_80 is not set
# CONFIG_ESP32S3_DEFAULT_CPU_FREQ_160 is not set
CONFIG_ESP32S3_DEFAULT_CPU_FREQ_240=y
CONFIG_ESP32S3_DEFAULT_CPU_FREQ_MHZ=240
 
CONFIG_ESP_DEFAULT_CPU_FREQ_MHZ_240=y
CONFIG_ESP_DEFAULT_CPU_FREQ_MHZ=240

#CONFIG_ESPTOOLPY_FLASHMODE_QIO=y
#CONFIG_ESPTOOLPY_FLASHFREQ_80M=y


# ==================================================== wifi and network =============================

#---------- HTTP Server Optimization ----------------
# Enable WebSocket support
CONFIG_HTTPD_WS_SUPPORT=y

# Increase max request header length for browser compatibility
CONFIG_HTTPD_MAX_REQ_HDR_LEN=2048

# Increase max URI length for long query strings
CONFIG_HTTPD_MAX_URI_LEN=1024

# Enable TCP_NODELAY for faster error responses
CONFIG_HTTPD_ERR_RESP_NO_DELAY=y

# Increase purge buffer for faster data handling
CONFIG_HTTPD_PURGE_BUF_LEN=256

#=================================
# WiFi Performance Optimization for Maximum Speed
# https://docs.espressif.com/projects/esp-idf/zh_CN/latest/esp32s3/api-guides/performance/speed.html

#---------- WiFi Buffer Configuration (High Performance) ----------------
CONFIG_ESP_WIFI_STATIC_RX_BUFFER_NUM=32
# Dynamic RX buffer: match esp32s2 for higher throughput
CONFIG_ESP_WIFI_DYNAMIC_RX_BUFFER_NUM=64
# Dynamic TX buffer: match esp32s2 for higher throughput
CONFIG_ESP_WIFI_DYNAMIC_TX_BUFFER_NUM=64

#---------- AMPDU (Block Acknowledgment) - Critical for speed ----------------
# Enable AMPDU for higher throughput
CONFIG_ESP_WIFI_AMPDU_TX_ENABLED=y
CONFIG_ESP_WIFI_TX_BA_WIN=32
CONFIG_ESP_WIFI_AMPDU_RX_ENABLED=y
CONFIG_ESP_WIFI_RX_BA_WIN=32

#---------- lwIP TCP/IP Stack Optimization ----------------
# Maximum TCP send buffer size
CONFIG_LWIP_TCP_SND_BUF_DEFAULT=65535
# Maximum TCP receive window size
CONFIG_LWIP_TCP_WND_DEFAULT=65535
# TCP/IP task mailbox sizes
CONFIG_LWIP_TCP_RECVMBOX_SIZE=64
CONFIG_LWIP_UDP_RECVMBOX_SIZE=64
CONFIG_LWIP_TCPIP_RECVMBOX_SIZE=64

# Set a fixed TinyUSB serial string so host tools can discover the device
# If your ESP-IDF/TinyUSB Kconfig symbol differs, adjust accordingly in menuconfig.
CONFIG_TINYUSB_DESC_SERIAL="ESP32SCR"

#---------- WiFi IRAM Optimization (Enable for Speed) ----------------
# Place WiFi library functions in IRAM for faster execution
CONFIG_ESP_WIFI_IRAM_OPT=y
CONFIG_ESP_WIFI_RX_IRAM_OPT=y

#---------- Additional Performance Options ----------------
# Enable WiFi cache TX buffers (improve throughput)
CONFIG_ESP_WIFI_CACHE_TX_BUFFER_NUM=32

# lwIP additional optimizations
CONFIG_LWIP_IRAM_OPTIMIZATION=y
CONFIG_LWIP_TCP_MSS=1440

# Enable TCP_NODELAY by default (reduce latency for small packets)
CONFIG_LWIP_TCP_NODELAY=y

# Reduce TCP retransmission timeout for faster recovery
CONFIG_LWIP_TCP_RTO_TIME=1500

# Increase maximum segment lifetime
CONFIG_LWIP_TCP_MSL=60000

# Enable TCP keepalive
CONFIG_LWIP_TCP_KEEPALIVE=y

#---------- ESP32-S3 Specific Performance Optimization ----------------
# ESP32-S3 supports higher WiFi TX power (max 20.5dBm)
CONFIG_ESP_PHY_MAX_WIFI_TX_POWER=12

# Enable WiFi NVS flash - faster WiFi connection
CONFIG_ESP_WIFI_NVS_ENABLED=y

# WiFi Task core binding - S3 is dual-core, bind to Core 0 for performance
CONFIG_ESP_WIFI_TASK_PINNED_TO_CORE_0=y

# Increase WiFi Task stack size for higher throughput
CONFIG_ESP_WIFI_TASK_STACK_SIZE=4096

# lwIP Task bind to Core 1 (separate from WiFi processing)
CONFIG_LWIP_TCPIP_TASK_AFFINITY_CPU1=y

# Increase lwIP Task stack size
CONFIG_LWIP_TCPIP_TASK_STACK_SIZE=4096

# Enable lwIP performance mode (ESP32-S3 dual-core advantage)
CONFIG_LWIP_TCPIP_CORE_LOCKING=y
CONFIG_LWIP_TCPIP_CORE_LOCKING_INPUT=y

# Enable ESP32-S3 hardware acceleration
CONFIG_ESP_WIFI_SOFTAP_BEACON_MAX_LEN=752
CONFIG_ESP_WIFI_MGMT_SBUF_NUM=32

# FreeRTOS optimization - utilize S3 dual cores
CONFIG_FREERTOS_UNICORE=n
CONFIG_FREERTOS_OPTIMIZED_SCHEDULER=y

# Enable more aggressive compiler optimization (S3 has more memory)
CONFIG_COMPILER_OPTIMIZATION_PERF=y

# WiFi protocol optimization
CONFIG_ESP_WIFI_ENABLE_WPA3_SAE=y
CONFIG_ESP_WIFI_SOFTAP_SAE_SUPPORT=y

# Network interface optimization
CONFIG_LWIP_MAX_SOCKETS=16
CONFIG_LWIP_SO_REUSE=y
CONFIG_LWIP_SO_RCVBUF=y

# TCP window scaling support (improve performance on high-latency networks)
CONFIG_LWIP_WND_SCALE=y
CONFIG_LWIP_TCP_RCV_SCALE=2

# Enable TCP congestion control algorithm optimization
CONFIG_LWIP_TCP_OVERSIZE_MSS=y

# PSRAM optimization - S3 can use faster PSRAM configuration
# Note: If hardware supports, can try 120MHz
# CONFIG_SPIRAM_SPEED_120M=y

#---------- 2MB PSRAM Additional Optimization ----------------
# Data cache line size optimization
CONFIG_ESP32S3_DATA_CACHE_LINE_64B=y

# Instruction cache line size optimization
CONFIG_ESP32S3_INSTRUCTION_CACHE_LINE_32B=y

# Increase HTTP server buffer - 2MB PSRAM is sufficient
CONFIG_HTTPD_MAX_REQ_HDR_LEN=4096
CONFIG_HTTPD_MAX_URI_LEN=2048

# Increase lwIP memory pool - utilize 2MB PSRAM
CONFIG_LWIP_MEM_SIZE=131072

# Increase PBUF pool size
CONFIG_LWIP_PBUF_POOL_SIZE=128

# Enable PSRAM as primary storage for WiFi buffers
CONFIG_ESP_WIFI_RX_BA_WIN=64
CONFIG_ESP_WIFI_TX_BA_WIN=64

# Increase static RX buffer count (sufficient PSRAM available)
CONFIG_ESP_WIFI_STATIC_RX_BUFFER_NUM=32
```
